; Pattern Generator Table
;  v9938 Text Mode 1
; Characters in 6*8, based on ISO 8859-15

Pattern_Generator_Table:
; ASCII 0x00 to 0x1F: Control Characters (here represented as full blocks)
    DB 0xFC, 0x84, 0x84, 0x84, 0x84, 0x84, 0xFC, 0x00 ; Char 0x00
    DB 0xFC, 0x84, 0x84, 0x84, 0x84, 0x84, 0xFC, 0x00 ; Char 0x01
    DB 0xFC, 0x84, 0x84, 0x84, 0x84, 0x84, 0xFC, 0x00 ; Char 0x02
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    DB 0xFC, 0x84, 0x84, 0x84, 0x84, 0x84, 0xFC, 0x00 ; Char 0x1F
; ASCII 0x20 to 0x7F: Standard Characters
    DB 0x00, 0x00, 0x00, 0x00, 0x00, 0x00, 0x00, 0x00 ; Char 0x20 ' '
    DB 0x20, 0x20, 0x20, 0x20, 0x00, 0x00, 0x20, 0x00 ; Char 0x21 '!'
    DB 0x50, 0x50, 0x50, 0x00, 0x00, 0x00, 0x00, 0x00 ; Char 0x22 '"'
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    DB 0x00, 0x00, 0x00, 0x00, 0x00, 0x00, 0x00, 0x00 ; Char 0x7F 'Del Key'

; Box Drawing characters (placeholders)
    DB 0x00, 0x00, 0x00, 0xFF, 0x00, 0x00, 0x00, 0x00 ; Char 0x80 '─'
    DB 0x10, 0x10, 0x10, 0x10, 0x10, 0x10, 0x10, 0x10 ; Char 0x81 '│'
    DB 0x00, 0x00, 0x00, 0x1F, 0x10, 0x10, 0x10, 0x10 ; Char 0x82 '┌'
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    DB 0x33, 0x33, 0xCC, 0xCC, 0x33, 0x33, 0xCC, 0xCC ; Char 0x9F '▒'

; Extended characters 0xA0 to 0xBF
    DB 0x00, 0x00, 0x00, 0x00, 0x00, 0x00, 0x00, 0x00 ; Char 0xA0 NBSP
    DB 0x20, 0x00, 0x00, 0x20, 0x20, 0x20, 0x20, 0x00 ; Char 0xA1 '¡'
    DB 0x20, 0x20, 0x78, 0x80, 0x80, 0x78, 0x20, 0x20 ; Char 0xA2 '¢'
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    DB 0x20, 0x00, 0x20, 0x40, 0x80, 0x88, 0x70, 0x00 ; Char 0xBF '¿'

; Matheamatical/Greek Symbols 0xC0 to 0xDF
    DB 0x00, 0x00, 0x68, 0x90, 0x90, 0x90, 0x68, 0x00 ; Char 0xC0 'α'
    DB 0x30, 0x48, 0x48, 0x70, 0x48, 0x48, 0x70, 0xC0 ; Char 0xC1 'β'
    DB 0xF8, 0x88, 0x80, 0x80, 0x80, 0x80, 0x80, 0x00 ; Char 0xC2 'Γ'
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    DB 0x88, 0x10, 0x20, 0x40, 0x80, 0x28, 0x00, 0x00 ; Char 0xDF '‰' permille

; Accented lowercase letters 0xE0 to 0xFF
    DB 0x20, 0x10, 0x70, 0x08, 0x78, 0x88, 0x78, 0x00 ; Char 0xE0 'à'
    DB 0x10, 0x20, 0x70, 0x08, 0x78, 0x88, 0x78, 0x00 ; Char 0xE1 'á'
    DB 0x20, 0x50, 0x70, 0x08, 0x78, 0x88, 0x78, 0x00 ; Char 0xE2 'â'
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    DB 0x90, 0x00, 0x90, 0x90, 0xB0, 0x50, 0x10, 0xE0 ; Char 0xFF 'ÿ'

; Additional Characters - Not in the pattern table by default
    DB 0xC0, 0xA0, 0xA0, 0xC8, 0x9C, 0x88, 0x88, 0x8C ; Char 0xnnn '₧' Pesetas
    DB 0x18, 0x20, 0x20, 0xF8, 0x20, 0x20, 0x20, 0x40 ; Char 0xnnn 'F' Francs
    DB 0x28, 0x50, 0x00, 0x88, 0x88, 0x88, 0x70, 0x00 ; Char 0x168 'Ũ'
    DB 0x50, 0xA0, 0x00, 0xA0, 0xA0, 0xA0, 0x50, 0x00 ; Char 0x169 'ũ'
    DB 0xFC, 0x48, 0x48, 0x48, 0xE8, 0x08, 0x50, 0x20 ; Char 0x0132 'Ĳ'
    DB 0x00, 0x50, 0x00, 0x50, 0x50, 0x50, 0x10, 0x20 ; Char 0x0133 'ĳ'
    DB 0x00, 0x60, 0x90, 0x90, 0x90, 0x60, 0x00, 0xF0 ; Char 0xnnnn 'o underscore'
    DB 0x00, 0x70, 0x08, 0x78, 0x88, 0x78, 0x00, 0xF8 ; Char 0xnnn 'a underscore'

; Box Drawing characters (placeholders)
    DB 0x00, 0x00, 0x00, 0xFF, 0x00, 0x00, 0x00, 0x00 ; Char 0x80 '─'
    DB 0x10, 0x10, 0x10, 0x10, 0x10, 0x10, 0x10, 0x10 ; Char 0x81 '│'
    DB 0x00, 0x00, 0x00, 0x1F, 0x10, 0x10, 0x10, 0x10 ; Char 0x82 '┌'
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    DB 0x33, 0x33, 0xCC, 0xCC, 0x33, 0x33, 0xCC, 0xCC ; Char 0x9F '▒'

; Semigraphics characters 0x80 to 0x9F
    DB 0xC0, 0xC0, 0xC0, 0xC0, 0xC0, 0xC0, 0xC0, 0xC0 ; Char 0x80 '▎'
    DB 0xF0, 0xF0, 0xF0, 0xF0, 0xF0, 0xF0, 0xF0, 0xF0 ; Char 0x81 '▌'
    DB 0xFC, 0xFC, 0xFC, 0xFC, 0xFC, 0xFC, 0xFC, 0xFC ; Char 0x82 '▊'
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    DB 0xFC, 0x84, 0x84, 0x84, 0x84, 0x84, 0xFC, 0x00 ; Char 0x9F