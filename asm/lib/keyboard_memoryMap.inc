
    IFNDEF __KBD_MEMORY_MAP__
    DEFINE __KBD_MEMORY_MAP__ 1

;KEYBOARD_RAM_START EQU RAM_START + 0x0100 ; Start of Keyboard RAM area
; ======= Keyboard Variables =======
KEYBOARD_MODIFIERS EQU KEYBOARD_RAM_START + 0x0000 ; 1 byte
KEYBOARD_CAPSLOCK_STATUS EQU KEYBOARD_MODIFIERS + 0x0001 ; 1 byte
KBD_RING_BUFFER EQU KEYBOARD_CAPSLOCK_STATUS + 0x0001 ; start of ring buffer (8 bytes)

KBD_BUFFER_DATA EQU KBD_RING_BUFFER + RING_BUFFER ; buffer data (BUFFER_SIZE bytes)

KEYBOARD_BUFFER_SIZE EQU 0x09 ; buffer length for keys
KEYBOARD_STATE EQU KBD_BUFFER_DATA + KEYBOARD_BUFFER_SIZE ; Keyboard state - ROWs * COLS bytes
KEYBOARD_RAM_END EQU KEYBOARD_STATE + (KEYBOARD_ROWS * KEYBOARD_COLUMNS) + 8; end of Keyboard RAM area

    ENDIF ; __KBD_MEMORY_MAP__
    