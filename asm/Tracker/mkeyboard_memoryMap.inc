
    IFNDEF __M_KBD_MEMORY_MAP__
    DEFINE __M_KBD_MEMORY_MAP__ 1

M_KEYBOARD_RAM_START EQU 0x8000 ; Start of Keyboard RAM area
; ======= Keyboard Variables =======
M_KEYBOARD_ONKEYPRESSED_HANDLER EQU M_KEYBOARD_RAM_START + 0x0000 ; address of the on key pressed handler (2 bytes)
M_KEYBOARD_ONKEYRELEASED_HANDLER EQU M_KEYBOARD_ONKEYPRESSED_HANDLER + 0x0002 ; address of the on key released handler (2 bytes)
M_KEYBOARD_MODIFIERS EQU M_KEYBOARD_ONKEYRELEASED_HANDLER + 0x0002 ; 1 byte
;KEYBOARD_CAPSLOCK_STATUS EQU KEYBOARD_MODIFIERS + 0x0001 ; 1 byte
;KBD_RING_BUFFER EQU KEYBOARD_CAPSLOCK_STATUS + 0x0001 ; start of ring buffer (8 bytes)

;KBD_BUFFER_DATA EQU KBD_RING_BUFFER + RING_BUFFER ; buffer data (BUFFER_SIZE bytes)

;KEYBOARD_BUFFER_SIZE EQU 0x09 ; buffer length for keys
M_KEYBOARD_STATE EQU M_KEYBOARD_MODIFIERS + 1 ; Keyboard state - ROWs * COLS bytes
M_KEYBOARD_COLUMNS EQU 13 ; number of columns
M_KEYBOARD_ROWS EQU 4 ; number of rows
;KEYBOARD_RAM_END EQU KEYBOARD_STATE + (KEYBOARD_ROWS * KEYBOARD_COLUMNS) + 8; end of Keyboard RAM area

    ENDIF ; __M_KBD_MEMORY_MAP__